/*
  random sound + deounce
  

*/

#include <PCM.h>

#define SPEAKER 11

int buttons[] = {4,5,6,7,2};
int leds[] = {A0,A1,A2,A3};

boolean wasPressed[5] = {false,false,false,false,false};
int whichButtonWasPressed = 100;
boolean pressedInGeneral = false;
int buttonState = 0;

int recall[] = {0,0,0,0};
boolean foundOpenSpot = false;
int nextOpenIndex = 4;
boolean allFilled = false;

int pattern[4] = {};
boolean toGeneratePattern = false;

boolean matched = false;
boolean inMatchMode = false;

const unsigned char cat[] PROGMEM = {
  126, 125, 126, 128, 128, 128, 128, 128, 128, 127, 127, 128,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 127

};
const unsigned char cow[] PROGMEM = {
129, 127, 122, 125, 131, 127, 118, 120, 127, 128, 127, 129,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 128
  
};
const unsigned char goat[] PROGMEM = {
125, 128, 132, 138, 125, 123, 130, 133, 122, 118, 135, 135,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 128
  
};


void setup() {
  pinMode(buttons[0], INPUT);
  pinMode(buttons[1], INPUT);
  pinMode(buttons[2], INPUT);
  pinMode(buttons[3], INPUT);
  pinMode(buttons[4], INPUT);
  Serial.begin(9600);
}


void loop() {
  patternCheck();
  getPatternCheck(toGeneratePattern);
  recallCheck();
  getRecallCheck(pressedInGeneral);
}

//======= pattern ==================================================

//check whether "random" button is pressed
void patternCheck(){
  buttonState = digitalRead(buttons[4]);
  if (buttonState != wasPressed[4]) {
    if (!buttonState) {
      Serial.println("5 is pressed");
      toGeneratePattern = true;
    } else {
      Serial.println("released");
      toGeneratePattern=false;
    }
  }
  wasPressed[4] = buttonState;
}

void getPatternCheck(boolean toGeneratePattern){
  if (toGeneratePattern){
    recallReset();
    getPattern();
  }
}

void getPattern(){
  Serial.print("pattern is ");
  for (int i = 0; i<4; i++){
    int j = random(1,5);
    pattern[i] = j;
   if (i!=3){
      if (pattern[i]!=1){
        playPattern(pattern[i]);
        delay(1000);
      } else {
        playPattern(pattern[i]);
      }
    } else {
      playPattern(pattern[i]);
    }
  }
  Serial.print("\n");
  inMatchMode = true;
}

void playPattern(int j){
  if (j==1){
     Serial.print(j);
     makeTweet();
  } else if(j==2){
     Serial.print(j);
     startPlayback(cat, sizeof(cat));
  } else if (j==3) {
     Serial.print(j);
     startPlayback(goat, sizeof(goat));
  } else if (j== 4) {
     Serial.print(j);
     startPlayback(cow, sizeof(cow));
  }
}

//======= recall ==================================================

//check all 4 buttons to see which one is pressed
void recallCheck(){
  for (int i=0;i<4;i++){
    buttonState = digitalRead(buttons[i]);
    if (buttonState != wasPressed[i]) {
      if (!buttonState) {        
        whichButtonWasPressed = i+1;
        Serial.print(whichButtonWasPressed);
        Serial.println(" is pressed");
        //set this button to be ready to be logged into recall
        pressedInGeneral = true;
      } else {
        //Serial.print(whichButtonWasPressed);
        //Serial.println(" is released");
        pressedInGeneral =false;
      }
    }
    wasPressed[i] = buttonState;
  }
}

void getRecallCheck(boolean pressedInGeneral){
   if (pressedInGeneral){
    getRecall(); //this is what logs the button number
  }
  pressedInGeneral =false;
}

//get which button is pressed and store in the next open spot in recall
//ie. when you press on button 3, the serial should only print button 3 was pressed, others were not
void getRecall(){
  //Serial.print("recall is ");
  Serial.println("=====================");
   for (int j=0;j<4;j++){
       //if recall[j] is 0, meaning it's open
       if (!recall[j] && !foundOpenSpot){
         nextOpenIndex = j;
         foundOpenSpot = true;
       }
   }
   fillAvailableRecallSpot();
  //if the last element in recall is not 0, that means it's all filled, so print recall
  if (recall[3]){allFilled = true;}
  if (allFilled){
      Serial.println("all filled");
      printRecalls();
      checkMode(inMatchMode);
      inMatchMode = false;
      Serial.println("\n");
  } else {
    Serial.println("have spot");
  }
  Serial.println("=====================");
  //since logged the button number, reset nextOpenSpot and foundOpenSpot
   nextOpenIndex = 4;
   foundOpenSpot=false;
   whichButtonWasPressed = 0;
}



void playRecall(int i){
  Serial.print("log button number ");
  if (i==1){
    analogWrite(leds[i-1], 1024);
    makeTweet();
    //delay(500);
    analogWrite(leds[i-1],0);
    Serial.println(i);
  } else if (i==2){
    Serial.println(i);
    analogWrite(leds[i-1], 1024);
    startPlayback(cat, sizeof(cat));
    delay(600);
    analogWrite(leds[i-1],0);
  } else if (i==3){
    Serial.println(i);
    analogWrite(leds[i-1], 1024);
    startPlayback(goat, sizeof(goat));
    delay(600);
    analogWrite(leds[i-1],0);
  } else if (i==4){
    Serial.println(i);
    analogWrite(leds[i-1], 1024);
    startPlayback(cow, sizeof(cow));
    delay(600);
    analogWrite(leds[i-1],0);
  } else {
    Serial.print("nothing");
    Serial.println("\n");
  }
}

 void fillAvailableRecallSpot(){
    //if there is a open spot, and whichButtonWasPressed is not 0
   Serial.print("whichButtonWasPressed is ");
   Serial.println(whichButtonWasPressed);
   if (foundOpenSpot){
       //log the button number to recall
       recall[nextOpenIndex] = whichButtonWasPressed;
       Serial.print("open index is ");
       Serial.println(nextOpenIndex);
       playRecall(recall[nextOpenIndex]);
       delay(600);
   }
 }


void recallReset(){
  for (int i=0; i<4; i++){
    recall[i]=0;
  }
  allFilled = false;
  Serial.println("recalls reset");
  printRecalls();
}

void printRecalls(){
  Serial.print("Recall is ");
    for (int j=0;j<4;j++){
      Serial.print(recall[j]);
    }
  Serial.println("\n");
}

//======= compare ==================================================

void compare(){
  if (recall[0]==pattern[0]){
    Serial.println("first match");
    if (recall[1]==pattern[1]){
      Serial.println("second match");
      if (recall[2]==pattern[2]){
        Serial.println("third match");
        if (recall[3]==pattern[3]){
          Serial.println("fourth match");
          matched = true;
        } else{
          matched = false;
        }
      } else{
          matched = false;
      }
    } else{
          matched = false;
      }
  } else{
      matched = false;
  }
  showResult(matched);
}

void showResult(boolean matched){
  if (matched){
    //hurray!
    Serial.println("hurray!!! :)");
    playMatchSound();
  } else {
    //oh no!! 
    Serial.println("uh oh :P");
    playMismatchSound();
  }
}


void checkMode(boolean inMatchMode){
  if (!inMatchMode){
    recallReset();
    Serial.println("exit match mode");
  } else {
    Serial.println("in match mode");
    compare();
    Serial.println("exit match mode");
  }
}

void playMismatchSound(){
  tone(SPEAKER, 65, 50);
  delay(100);
  tone(SPEAKER, 65, 400);
  delay(2000);
}

void playMatchSound(){
  tone(SPEAKER, 783, 50);
  delay(100);
  tone(SPEAKER, 1318, 400);
  delay(2000);
}















//bird sound =======================================================
void makeTweet(){
  int counter = random(2,6);
  int angulo = random(10, 50);
  highChirp(5,angulo/10);
  delay(100);
  lowChirp(angulo*4,2);
  delay(100);
}

void highChirp(int intensity, int chirpsNumber){
  int i;
  int x;

  //for(int repeat=0; repeat<=chirpsNumber; repeat++){

  for (i=100; i>0; i--)
  {
    for  (x=0; x<intensity;  x++)
    {
      digitalWrite (SPEAKER,HIGH);
      delayMicroseconds (i);
      digitalWrite (SPEAKER,LOW);
      delayMicroseconds (i);
    }
  }
  //}
}


void lowChirp(int intensity, int chirpsNumber){
  int i;
  int x;
  for(int veces=0; veces<=chirpsNumber; veces++){
    for (i=0; i<200; i++)
    {
      digitalWrite (SPEAKER,HIGH);
      delayMicroseconds(i);
      digitalWrite(SPEAKER,LOW);
      delayMicroseconds(i);
    }
    for (i=90; i>80; i--)
    {
      for  ( x=0; x<5;  x++)
      {
        digitalWrite (SPEAKER,HIGH);
        delayMicroseconds (i);
        digitalWrite (SPEAKER,LOW);
        delayMicroseconds (i);
      }
    }
  }
}


